/*
 * Copyright (c) 2020 The ZMK Contributors
 *
 * SPDX-License-Identifier: MIT
 */

#include "cornelius.dtsi"

&kscan0 {
	/* 
	WHAT THIS FILE DOES:
	- This is the RIGHT side configuration
	- RIGHT side is the split peripheral (responds to connection)
	*/
};

&split {
	role = "peripheral";
};

&pro_micro_i2c {
	status = "disabled";
};
