/*
 * Copyright (c) 2020 The ZMK Contributors
 *
 * SPDX-License-Identifier: MIT
 */

#include "cornelius.dtsi"

&kscan0 {
	/* 
	WHAT THIS FILE DOES:
	- The .overlay file applies settings for a specific board/side
	- This is the LEFT side configuration
	- LEFT side is the split central (initiates connection)
	*/
};

&split {
	role = "central";
};

&pro_micro_i2c {
	status = "disabled";
	/* 
	I2C is disabled because we're not using I2C devices like OLED screens.
	If you add I2C peripherals in the future, you'd enable this.
	*/
};
